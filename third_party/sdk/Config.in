## third_party/sdk/gui-x86_64/Config.in
```kconfig
config BR2_PACKAGE_FOUNDATION_GUI_SDK
	bool "Native GUI development libraries"
	select BR2_PACKAGE_XORG7
	select BR2_PACKAGE_FLTK
	select BR2_PACKAGE_SDL2
	select BR2_PACKAGE_SDL2_X11
	select BR2_PACKAGE_LIBGLVND
	select BR2_PACKAGE_LIBGLVND_DISPATCH_GL
	select BR2_PACKAGE_XLIB_LIBX11
	select BR2_PACKAGE_XLIB_LIBXEXT
	select BR2_PACKAGE_XLIB_LIBXRENDER
	select BR2_PACKAGE_XLIB_LIBXFT
	select BR2_PACKAGE_XLIB_LIBXRANDR
```
